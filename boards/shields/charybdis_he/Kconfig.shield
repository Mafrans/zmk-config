## boards/shields/charybdis_he/Kconfig.shield
```kconfig
config SHIELD_CHARYBDIS_HE_LEFT
    def_bool $(shields_list_contains,charybdis_he_left)

config SHIELD_CHARYBDIS_HE_RIGHT
    def_bool $(shields_list_contains,charybdis_he_right)
```

## boards/shields/charybdis_he_l/Kconfig.defconfig
```kconfig
if SHIELD_CHARYBDIS_HE_L_LEFT

config ZMK_KEYBOARD_NAME
    default "charybdis-he-l"

config ZMK_SPLIT_ROLE_CENTRAL
    default y

endif # SHIELD_CHARYBDIS_HE_L_LEFT

if SHIELD_CHARYBDIS_HE_L_LEFT || SHIELD_CHARYBDIS_HE_L_RIGHT

config ZMK_SPLIT
    default y

endif # SHIELD_CHARYBDIS_HE_L_LEFT || SHIELD_CHARYBDIS_HE_L_RIGHT
```

## boards/shields/charybdis_he_l/Kconfig.shield
```kconfig
config SHIELD_CHARYBDIS_HE_L_LEFT
    def_bool $(shields_list_contains,charybdis_he_l_left)

config SHIELD_CHARYBDIS_HE_L_RIGHT
    def_bool $(shields_list_contains,charybdis_he_l_right)
```

## config/west.yml
```yaml
manifest:
  defaults:
    revision: main
  remotes:
    - name: zmkfirmware
      url-base: https://github.com/zmkfirmware
    - name: cr3eperall
      url-base: https://github.com/cr3eperall
  projects:
    - name: zmk
      remote: zmkfirmware
      import: app/west.yml
    - name: zmk-feature-hall-effect
      remote: cr3eperall
  self:
    path: config
```
